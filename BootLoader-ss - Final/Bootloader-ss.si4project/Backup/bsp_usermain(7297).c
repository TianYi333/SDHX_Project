#include "bsp_usermain.h"
#include "stdlib.h"
#include "string.h"

#define APP_FLASH_ADDRESS (0x8008000) //程序地址从0x8000004+0x8000开始，为BootLoader留了0x8000（32Kb）
#define WRITE_END_ADDRESS (0x803FFFF) //写程序结束地址

#define DISPLAY_INTERVAL_CNT  17


typedef void (*pFunction)(void);
pFunction Jump_To_Application;
uint32_t JumpAddress;
uint32_t AppAddress;

uint8_t Status_Flag = 0; //状态标志位 0：准备状态 1：接收状态
uint8_t End_Flag = 0;    //结束标志位 0：接收未结束 1：接收结束
uint8_t Trans_Flag = 0;  //传输开始标志位 0：程序未开始传输 1：程序开始传输

//uint8_t *Program_Buffer = NULL;
uint8_t Program_Buffer[131072];	//分配128K空间

uint8_t *CAN_Recieve_Buffer = NULL;
uint32_t *Program_Program_Buffer = NULL;

uint32_t Program_Percent = 0;
volatile uint32_t Program_Size_Theoretical = 0; //最开始发送过来的程序大小
volatile uint32_t Program_Size_Actual = 0;      //实际接收到的程序大小

uint8_t Checksum_Value = 0;		//计算所得校验和
uint8_t Checksum_Value_recv = 0;		//接收校验和
uint32_t nTemp_Value = 0;		//临时变量
volatile uint32_t Transmit_Tickstart;
volatile uint32_t Transmit_Ticknow;
volatile uint32_t Transmit_Timeout_Cnt;
static uint32_t Display_Num_Integer,Display_Num_Integer_Last,Display_Num_Decimal;


////公司LOGO
const unsigned char gImage_1[] = {
0x00,0x00,0x00,0x00,0x00,0x00,0x00,0x00,0x00,0x00,0x00,0x00,0x00,0x00,0x00,0x00,
0x00,0x00,0x00,0x00,0x00,0x00,0x00,0x00,0x00,0x00,0x00,0x00,0x00,0x00,0x00,0x00,
0x00,0x00,0x00,0x00,0x00,0x00,0x00,0x00,0x00,0x00,0x00,0x00,0x00,0x00,0x00,0x00,
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0x00,0x00,0x00,0x00,0x00,0x00,0x00,0x00,0x00,0x00,0x00,0x00,0x00,0x00,0x00,0x00
};
////公司LOGO

uint8_t space_code[16] = {0,0,0,0,0,0,0,0,0,0,0,0,0,0,0,0};

uint8_t gb2312_code[1072] = {
    0x00, 0xE0, 0x10, 0x08, 0x08, 0x10, 0xE0, 0x00, 0x00, 0x0F, 0x10, 0x20, 0x20, 0x10, 0x0F, 0x00, /*"0"*/

    0x00, 0x00, 0x10, 0x10, 0xF8, 0x00, 0x00, 0x00, 0x00, 0x00, 0x20, 0x20, 0x3F, 0x20, 0x20, 0x00, /*"1"*/
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    0x22, 0x67, 0x22, 0x12, 0x12, 0x80, 0x40, 0x30, 0x0F, 0x00, 0x00, 0x3F, 0x40, 0x40, 0x71, 0x00 /*"统"*/
};

FLASH_EraseInitTypeDef My_FLASH_Erase;
uint32_t Error = 0;
uint32_t Program_Program_Percent = 0;
uint32_t Program_Addr = APP_FLASH_ADDRESS;

uint8_t STMFLASH_ReadByte(uint32_t faddr)
{
	return *(uint8_t*)faddr; 
}

void STMFLASH_Read(uint32_t ReadAddr,uint8_t *pBuffer,uint32_t NumToRead)   	
{
	uint32_t i;
	for(i=0;i<NumToRead;i++)
	{
		pBuffer[i]=STMFLASH_ReadByte(ReadAddr);		//读取1个字节.
		ReadAddr++;		//偏移1个字节.	
	}
}
	
void JumpToApp(uint32_t app_addr)
{

  /* Check if valid stack address (RAM address) then jump to user application */
  if(((*(__IO uint32_t *)app_addr)&0x2FFE0000)==0x20000000)
  {
    __disable_irq();
    /* Jump to user application */
		AppAddress = *(volatile unsigned long*)(app_addr);
    JumpAddress = *(volatile unsigned long*)(app_addr + 4);
    Jump_To_Application = (pFunction)JumpAddress;
    /* Initialize user application's Stack Pointer */
    __set_MSP(*(volatile unsigned long*)AppAddress);
    Jump_To_Application();
  }
}


void MainInit(void)
{	
	
	OLED19264_INIT();
	Clear_Screen();
	CAN_Config_Ready(); 
	
  CAN_Recieve_Buffer = Program_Buffer;	
	
}


void MainWork(void)
{
	int Ready_Time;
	static uint32_t Program_Program_Percent_Last = 0;
	uint32_t Retry_cnt = 100;

	__enable_irq();
	Clear_Screen();
#if 1

	  for (Ready_Time = 0; Ready_Time < 50; Ready_Time++)
	  {
	    
	    switch (Ready_Time)
	    {
			case 0:
			  Clear_Screen();
			  Display_String(1, 32, "欢迎使用");
			  Display_String(4, 0, "山东矿机华信智能");
			  Display_String(7, 32, "电控系统");
			  break;
			case 20:
			  Clear_Screen();
			  display_graphic_128x64(1, 0, gImage_1);
			  Display_String(7, 20, "华 信 智 能");
			  break;
			default:
			  break;
	    }
		HAL_Delay(100);
	  }

#endif

  if (Status_Flag == 1)
  {
    Clear_Screen();
    Display_String(1, 32, "程序接收");
    Display_String(3, 40, "XX.XX%");


    while (Trans_Flag != 1)
    {
    	Transmit_Ticknow = HAL_GetTick();
		if(Transmit_Ticknow > Transmit_Tickstart)
		{
			Transmit_Timeout_Cnt = Transmit_Ticknow - Transmit_Tickstart;
		}
		else
		{
			Transmit_Timeout_Cnt = HAL_MAX_DELAY - Transmit_Tickstart + Transmit_Ticknow;
		}

		if(10000 < Transmit_Timeout_Cnt)
		{
			Clear_Screen();
	        Display_String(1, 16, "程序接收失败");
	        HAL_Delay(5000);
			JumpToApp(APP_FLASH_ADDRESS); //跳转到APP
		}
		
    }
    Display_String(1, 24, "程序接收中");
    while ((End_Flag != 1))
    {
      //计算程序接收百分比
      Program_Percent = (Program_Size_Actual * 10000) / Program_Size_Theoretical;
      //显示程序接收百分比
      Display_Singal_Num(3, 40, (Program_Percent / 100));
      Display_Singal_Num(3, 64, (Program_Percent % 100));
      HAL_Delay(100);
	  #if 1
      if ((Program_Size_Actual-8) > Program_Size_Theoretical) //接收到的程序大于实际程序
      {
        Clear_Screen();
        Display_String(1, 16, "程序接收失败");
        HAL_Delay(5000);
		JumpToApp(APP_FLASH_ADDRESS); //跳转到APP
      }
	  #endif
	  Transmit_Ticknow = HAL_GetTick();
		if(Transmit_Ticknow > Transmit_Tickstart)
		{
			Transmit_Timeout_Cnt = Transmit_Ticknow - Transmit_Tickstart;
		}
		else
		{
			Transmit_Timeout_Cnt = HAL_MAX_DELAY - Transmit_Tickstart + Transmit_Ticknow;
		}

		if(10000 < Transmit_Timeout_Cnt)
		{
			Clear_Screen();
	        Display_String(1, 16, "程序接收失败");
	        HAL_Delay(5000);
			JumpToApp(APP_FLASH_ADDRESS); //跳转到APP
		}
    }
	
  }
  
  if (End_Flag == 1) //传输已经结束，开始烧录
  {
		if (Program_Size_Actual == Program_Size_Theoretical)
    {
    	if(Checksum_Value_recv == Checksum_Value)
    	{
				Clear_Screen();
				Display_String(1, 16, "程序接收成功");
				Display_String(3, 40, "烧录中");
					//计算程序烧录百分比
				Program_Program_Percent = (pro_time * 10000) / Program_Size_Actual;
				//显示程序烧录百分比
				Display_Singal_Num(5, 40, (char)(Program_Program_Percent / 100));
				Display_String(5, 56, ".");
				Display_Singal_Num(5, 64, (char)(Program_Program_Percent % 100));
				Display_String(5, 80, "%");

				HAL_Delay(50);
    	}
			else
			{
						Clear_Screen();
						Display_String(1, 16, "程序失败");
						HAL_Delay(5000);
						JumpToApp(APP_FLASH_ADDRESS); //跳转到APP
			}
    }
    else //接收到的程序与实际程序不相等
    {
      Clear_Screen();
      Display_String(1, 16, "程序接收失败");
      HAL_Delay(5000);
	  JumpToApp(APP_FLASH_ADDRESS); //跳转到APP
    }
		
    //将程序写入内部flash
    
	__disable_irq();									//关总中断	
    HAL_FLASH_Unlock();						//解锁内部flash	
	__HAL_FLASH_DATA_CACHE_DISABLE();//FLASH操作期间，必须禁止数据缓存
    //擦除
    My_FLASH_Erase.TypeErase = FLASH_TYPEERASE_SECTORS;
    My_FLASH_Erase.Sector = FLASH_SECTOR_2;
    My_FLASH_Erase.NbSectors = 4;
    My_FLASH_Erase.VoltageRange = FLASH_VOLTAGE_RANGE_3;	

	__HAL_FLASH_CLEAR_FLAG(FLASH_FLAG_EOP    | FLASH_FLAG_OPERR | FLASH_FLAG_WRPERR | \
                         FLASH_FLAG_PGAERR | FLASH_FLAG_PGPERR | FLASH_FLAG_PGSERR);
#if 1
	while((HAL_FLASHEx_Erase(&My_FLASH_Erase, &Error))&&(Retry_cnt))
	{
		Retry_cnt--;
		if(!Retry_cnt)
		{
			Clear_Screen();
			Display_String(3, 40, "烧录中失败");
			HAL_Delay(5000);
			__HAL_FLASH_DATA_CACHE_ENABLE();//开启数据缓存
			HAL_FLASH_Lock(); 	//锁住Flash
			__enable_irq() ;	//开总中断
			JumpToApp(APP_FLASH_ADDRESS); //跳转到APP
		}
		HAL_Delay(100);
	}
#endif
    //烧录
  Program_Program_Buffer = (uint32_t*)Program_Buffer;

	Display_String(5, 105, "%");
#if 1		
	if(Program_Size_Actual%4)
	{
	    for (uint32_t pro_time = 0; pro_time < ((Program_Size_Actual/4)+1); pro_time++)
	    {
				if(WRITE_END_ADDRESS > Program_Addr)
				{
					while(HAL_FLASH_Program(FLASH_TYPEPROGRAM_WORD, Program_Addr, *Program_Program_Buffer))	
					{
						HAL_Delay(1000);
					}
					Program_Program_Buffer += 1;
					Program_Addr += 4;
				}

					//计算程序烧录百分比
					Program_Program_Percent = (pro_time * 40000) / Program_Size_Actual;
					//显示程序烧录百分比
					if(DISPLAY_INTERVAL_CNT < (Program_Program_Percent - Program_Program_Percent_Last))
					{
							Program_Program_Percent_Last = Program_Program_Percent;
							Display_Num_Integer = Program_Program_Percent / 100;
							Display_Num_Decimal = Program_Program_Percent % 100;
							if(Display_Num_Integer != Display_Num_Integer_Last)
							{
								Display_Num_Integer_Last = Display_Num_Integer;
								Display_Singal_Num(5, 40, (char)(Display_Num_Integer));
								Display_String(5, 56, ".");
							}
							Display_Singal_Num(5, 64, ((char)(Display_Num_Decimal)));   
					}

	    }
	}
	else
	{
	    for (uint32_t pro_time = 0; pro_time < (Program_Size_Actual/4); pro_time++)
	    {
				if(WRITE_END_ADDRESS > Program_Addr)
				{
					while(HAL_FLASH_Program(FLASH_TYPEPROGRAM_WORD, Program_Addr, *Program_Program_Buffer))	
					{
						HAL_Delay(1000);
					}
					Program_Program_Buffer += 1;
					Program_Addr += 4;
				}

				//计算程序烧录百分比
				Program_Program_Percent = (pro_time * 40000) / Program_Size_Actual;
				//显示程序烧录百分比
				if(DISPLAY_INTERVAL_CNT < (Program_Program_Percent - Program_Program_Percent_Last))
				{
						Program_Program_Percent_Last = Program_Program_Percent;
						Display_Num_Integer = Program_Program_Percent / 100;
						Display_Num_Decimal = Program_Program_Percent % 100;
						if(Display_Num_Integer != Display_Num_Integer_Last)
						{
							Display_Num_Integer_Last = Display_Num_Integer;
							Display_Singal_Num(5, 40, (char)(Display_Num_Integer));
							Display_String(5, 56, ".");
						}
						Display_Singal_Num(5, 64, ((char)(Display_Num_Decimal)));	
				}
			
	    }
	}
#endif
	__HAL_FLASH_DATA_CACHE_ENABLE();//开启数据缓存
	HAL_FLASH_Lock(); 	//锁住Flash
	__enable_irq() ;	//开总中断

	STMFLASH_Read(APP_FLASH_ADDRESS,Program_Buffer,Program_Size_Actual);
	nTemp_Value = 0;
	for(int ii = 0;ii < Program_Size_Actual;ii++)
	{
		nTemp_Value += Program_Buffer[ii];
		nTemp_Value = nTemp_Value&0xFF;
		Checksum_Value = nTemp_Value;
	}
	if(Checksum_Value_recv == Checksum_Value)
	{
		Clear_Screen();
		Display_String(3, 40, "烧录成功");
		HAL_Delay(10000);
	
	}
	else
	{
		Clear_Screen();
		Display_String(3, 40, "烧录失败");
		HAL_Delay(5000);
	}

		
  }
#if 0  
	if(NULL != Program_Buffer)
	{
  		free(Program_Buffer); //释放malloc的空间
  		Program_Buffer = NULL;
	}
#endif

  JumpToApp(APP_FLASH_ADDRESS); //跳转到APP
  
	while (1)
	{

		HAL_Delay(1000);

		
	}


	
}


